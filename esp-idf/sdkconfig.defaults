## esp-idf/sdkconfig.defaults
```kconfig
# Enable C++ exceptions and set emergency pool size for exception objects
CONFIG_COMPILER_CXX_EXCEPTIONS=y
CONFIG_COMPILER_CXX_EXCEPTIONS_EMG_POOL_SIZE=1024
CONFIG_LOG_DEFAULT_LEVEL=4
CONFIG_LOG_COLORS=y
```
